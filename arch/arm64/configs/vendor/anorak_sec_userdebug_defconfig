## kernel_platform/msm-kernel/drivers/battery/Kconfig
```kconfig
#
# battery driver configuration
#

comment "Battery drivers"

config BATTERY_SAMSUNG
	tristate "samsung battery driver"
	help
	 Say Y to include support for samsung battery driver
	 This battery driver integrated all battery-related functions
	 To see battery-related functions,
	 refer to sec_charging_common.h

source "drivers/battery/charger/max77705_charger/Kconfig"
source "drivers/battery/charger/sm5451_charger/Kconfig"
source "drivers/battery/charger/pca9482_charger/Kconfig"
source "drivers/battery/common/Kconfig"
source "drivers/battery/fuelgauge/max77705_fuelgauge/Kconfig"
source "drivers/battery/limiter/s2asl01/Kconfig"
source "drivers/battery/limiter/max17333/Kconfig"
```

## kernel_platform/msm-kernel/drivers/hwmon/sec_fan/Kconfig
```kconfig
#
# Sec Fan common & chip drivers configuration
#

config SEC_FAN
	tristate "Use external thermistor near AP for checking temperature"
	default n
	help
	  Use sec_fan sub-system for providing sec_fan interface with thermal engine
	  at userspace.

	  Please use the skeleton driver, ic_name-sec_fan.c for writing a new IC driver.

	  Note this is in primitive stage, so multiple device support, etc., are yet to be supported.

config SENSORS_MAX31760_SEC_FAN
	tristate "Maxim MAX31760 Precision fan controller"
	depends on I2C
	help
	  If you say yes here you get support for the Maxim Integrated
	  MAX31760 Precision Fan-Speed Controller with non volatile Look-Up
	  Table with Temperature Sensor.

	  This driver can also be built as a module.  If so, the module
	  will be called max31760.
```

## kernel_platform/msm-kernel/drivers/misc/kxrctrl/Kconfig
```kconfig
config KINECTICS_XR_NORDIC
    tristate "KXR Nordic SPI support"
    default m
    help
      Say Y here if you need KXR Nordic SPI support.

      If unsure, say N.

      To compile this driver as a module, choose M here: the
      module will be called kxr_aphost.
```

## kernel_platform/msm-kernel/drivers/optics/Kconfig
```kconfig
config SENSORS_STK6D2X
	tristate "STK STK68210 ALS, Flicker sensor"
	depends on I2C
	help
	  If you say yes here, you get support for the STK STK68210.
	  This driver can also be built as a module.
	  If so, the module will be called flicker_sensor.

config FLICKER_ANTI_ALIASING
	bool "Flicker Anti-Aliasing"
	default y
	help
	  This module calculate frequency with multi samplerate of flicker sensor
	  It needs multiple samplerate settings in flicker sensor
```

## kernel_platform/msm-kernel/drivers/samsung/power/Kconfig
```kconfig
config SEC_PM_LOG
	tristate "Samsung Power/Thermal Log driver"
	help
	  TODO: help is not ready.
```

## kernel_platform/msm-kernel/drivers/slider/Kconfig
```kconfig
config SLIDER_MOTOR
	tristate "SEC SLIDER MOTOR"
	default n
	help
	  If you say yes here you will get support for the
	  SEC SLIDER MOTOR.
```

## kernel_platform/msm-kernel/drivers/usb/typec/slsi/s2mm006/Kconfig
```kconfig
#
# PDIC devices
#

comment "PDIC configs"

config PDIC_S2MM006
	tristate "Using S2MM006 USB PD"
	default n
	help
	  If you say yes here you will get support for
	  for the S2MU106 USBPD chip.

config MUIC_S2MM006
	tristate "Using S2MM006 MUIC"
	depends on USE_MUIC
	default n
	help
	  If you say yes here you will get support for the S2MU106 MUIC chip.

config PDIC_ALTERNATE_MODE
	bool "PDIC_ALTERNATE_MODE"
	depends on I2C
	default n
	help
	  If you say yes here you will get support for
	  PDIC_ALTERNATE_MODE

config S2MM006_FW_DOWNLOAD
	bool "S2MM006_FW_DOWNLOAD"
	depends on I2C
	default n
	help
	  If you say yes here you will get support for
	  s2mm006 FW UPDATE

config S2MM006_POGO
	bool "S2MM006_POGO"
	depends on I2C
	default n
	help
	  If you say yes here you will get support for
	  2nd pogo connector with s2mm006 driver

config S2MM006_CC_UEVENT
	bool "S2MM006_CC_UEVENT"
	depends on I2C
	default n
	help
	  If you say yes here you will get support for
	  power control cc uevent with s2mm006 driver
```
