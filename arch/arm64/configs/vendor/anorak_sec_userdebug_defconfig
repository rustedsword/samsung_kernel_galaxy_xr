## drivers/adsp_factory/Kconfig
```kconfig
#
# factory sensor drivers configuration
#
config ADSP_FACTORY
	tristate "MSM ADSP factory driver"
	default n
	help
	  This driver communicate with SSC DAEMON.
	  register each sensor device.
	  send selftest request using netlink.
	  receive test result using netlink.

config LSM6DSV_FACTORY
	tristate "factory test for SSC - LSM6DSV"
	default n
	help
	  lsm6dsv factory driver.
	  provide sysfs for factory test.
	  request selftest to adsp_factory.
	  receive test result from adsp_factory.

config LSM6DSL_FACTORY
	tristate "factory test for SSC - LSM6DSL"
	default n
	help
	  lsm6dsl factory driver.
	  provide sysfs for factory test.
	  request selftest to adsp_factory.
	  receive test result from adsp_factory.

config AK09918_FACTORY
	tristate "factory test for SSC - ak09918"
	default n
	help
	  ak09918 factory driver.
	  provide sysfs for factory test.
	  request selftest to adsp_factory.
	  receive test result from adsp_factory.

config A96T3XX_FACTORY
	tristate "factory test for SSC - A96T3XX"
	default n
	help
	  a96t3xx factory driver.
	  provide sysfs for factory test.
	  request selftest to adsp_factory.
	  receive test result from adsp_factory.

config LPS22HH_FACTORY
	tristate "factory test for SSC - lps22hh"
	default n
	help
	  lps22hh factory driver.
	  provide sysfs for factory test.
	  request selftest to adsp_factory.
	  receive test result from adsp_factory.

config TMD490X_FACTORY
	tristate "factory test for SSC - tmd490x"
	default n
	help
	  tmd490x factory driver.
	  provide sysfs for factory test.
	  request selftest to adsp_factory.
	  receive test result from adsp_factory.

config SUPPORT_TMD4906_FACTORY
	tristate "factory test for SSC - tmd4906"
	depends on TMD490X_FACTORY
	default n
	help
	  tmd4906 factory driver
	  provide sysfs for factory test.
	  request selftest to adsp_factory.
	  receive test result from adsp_factory.

config SUPPORT_TMD4907_FACTORY
	tristate "factory test for SSC - tmd4907"
	depends on TMD490X_FACTORY
	default n
	help
	  tmd4907 factory driver
	  provide sysfs for factory test.
	  request selftest to adsp_factory.
	  receive test result from adsp_factory.

config SUPPORT_AMS_LIGHT_LCD_VERSION_DUALIZAION
	tristate "ams light lcd version for SSC"
	depends on TMD490X_FACTORY
	default n
	help
	  receive lcd type from lcd sysfs.
	  send lcd rev to light driver.

config SUPPORT_AMS_LIGHT_CALIBRATION
	tristate "ams light cal for SSC"
	depends on TMD490X_FACTORY
	default n
	help
	  AMS light calibration feature.
	  provide sysfs for light calibration.
	  request light cal to adsp_factory.
	  receive cal value from adsp_factory.

config SUPPORT_AMS_PROX_CALIBRATION
	tristate "ams prox cal for SSC"
	depends on TMD490X_FACTORY
	default n
	help
	  AMS prox calibration feature.
	  provide sysfs for prox calibration.
	  request prox cal to adsp_factory.
	  receive cal value from adsp_factory.

config TCS3701_FACTORY
	tristate "factory test for SSC - TCS3701"
	default n
	help
	  tcs3701 factory driver.
	  provide sysfs for factory test.
	  request selftest to adsp_factory.
	  receive test result from adsp_factory.

config STK3331_FACTORY
	tristate "factory test for SSC - STK3331"
	default n
	help
	  stk3331 factory driver.
	  provide sysfs for factory test.
	  request selftest to adsp_factory.
	  receive test result from adsp_factory.

config STK3013_FACTORY
	tristate "factory test for SSC - STK3013"
	default n
	help
	  stk3331 factory driver.
	  provide sysfs for factory test.
	  request selftest to adsp_factory.
	  receive test result from adsp_factory.

config SUPPORT_PROX_AUTO_CAL
	tristate "Support Auto Calibration for proximity sensor - tmd490x"
	default n
	depends on TMD490X_FACTORY
	help
	  Support the Auto Calibration function in tmd490x.
	  provide sysfs for factory test.
	  request selftest to adsp_factory.
	  receive test result from adsp_factory.

config SUPPORT_HIDDEN_HOLE
	tristate "Support Hidden Hole function for proximity sensor"
	default n
	depends on ADSP_FACTORY
	help
	  Support the Hidden Hole function.
	  provide sysfs for factory test.
	  request selftest to adsp_factory.
	  receive test result from adsp_factory.

config SUPPORT_HIDDEN_HOLE_SUB
	tristate "Support Hidden Hole Sub function for proximity sensor"
	default n
	depends on ADSP_FACTORY
	help
	  Support the Hidden Hole Sub function.
	  provide sysfs for factory test.
	  request selftest to adsp_factory.
	  receive test result from adsp_factory.

config SLPI_MOTOR
	tristate "Sensors support motor"
	default n
	help
	  Support the motor state function
	  provide sysfs for factory test.
	  request selftest to adsp_factory.
	  receive test result from adsp_factory.

config SUPPORT_MOTOR_NOTIFIER
	tristate "Sensors support motor notifier"
	depends on SLPI_MOTOR
	default n
	help
	  Support the motor notifier function
	  receive motor start setting.

config SUPPORT_MOBEAM
	tristate "Sensors support mobeam"
	default n
	help
	  Support the mobeam
	  provide sysfs for factory test.
	  request selftest to adsp_factory.
	  receive test result from adsp_factory.

config SUPPORT_SUB_MOBEAM
	tristate "Sensors support sub mobeam"
	depends on SUPPORT_MOBEAM
	help
	  Support the sub mobeam
	  provide sysfs for factory test.
	  request selftest to adsp_factory.
	  receive test result from adsp_factory.

config SUPPORT_PROX_POWER_ON_CAL
	tristate "Sensors support proximity sensor power on cal"
	default n
	help
	  Support power on calibration for proximity sensor
	  make calibration process done as the device power up.

config SUPPORT_BRIGHTNESS_NOTIFY_FOR_LIGHT_SENSOR
	tristate "Sensors support brightness notify"
	default n
	help
	  Support brightness notify for light sensor.
	  receive aor and brightness level from lcd driver.

config SUPPORT_DDI_COPR_FOR_LIGHT_SENSOR
	tristate "Sensors support ddi copr"
	default n
	help
	  Support ddi copr for light sensor.
	  provide copr sysfs for factory and afc service.
	  DDI must be connected with sensor core

config SUPPORT_UNDER_PANEL_WITH_LIGHT_SENSOR
	tristate "Sensors support under panel with light sensor"
	default n
	help
	  Support under panel with light sensor.
	  provide sysfs for lux compensation.

config SUPPORT_DUAL_6AXIS
	tristate "Sensors support dual 6axis"
	default n
	help
	  Support the dual accel and gyro function.
	  provide sysfs for factory test.
	  request selftest to adsp_factory.
	  receive test result from adsp_factory.

config SUPPORT_DUAL_OPTIC
	tristate "Sensors support dual optic"
	default n
	help
	  Support the dual prox and light function.
	  provide sysfs for factory test.
	  request selftest to adsp_factory.
	  receive test result from adsp_factory.

config SUPPORT_VIRTUAL_OPTIC
	tristate "Sensors support virtual optic"
	default n
	help
	  Support the virtual prox and light function.
	  provide sysfs for factory test.
	  request selftest to adsp_factory.
	  receive test result from adsp_factory.

config SUPPORT_DEVICE_MODE
	tristate "Support device mode"
	default n
	help
	  Support device mode.

config VEML3328_FACTORY
	tristate "factory test for SSC - veml3328"
	default n
	help
	  veml3328 factory driver.
	  provide sysfs for factory test.
	  request selftest to adsp_factory.
	  receive test result from adsp_factory.

config ICM42605_FACTORY
	tristate "factory test for SSC - ICM42605"
	default n
	help
	  icm42605 factory driver.
	  provide sysfs for factory test.
	  request selftest to adsp_factory.
	  receive test result from adsp_factory.

config TCS3701_FACTORY
	tristate "factory test for SSC - TCS3701"
	default n
	help
	  tcs3701 factory driver.
	  provide sysfs for factory test.
	  request selftest to adsp_factory.
	  receive test result from adsp_factory.

config STK33617_FACTORY
	tristate "factory test for SSC - STK33617"
	default n
	help
	  STK33617 factory driver.
	  provide sysfs for factory test.
	  request selftest to adsp_factory.
	  receive test result from adsp_factory.

config STK3A5X_FACTORY
	tristate "factory test for SSC - STK3A5X"
	default n
	help
	  STK33617 factory driver.
	  provide sysfs for factory test.
	  request selftest to adsp_factory.
	  receive test result from adsp_factory.

config GP2AP110S_FACTORY
	tristate "factory test for SSC - GP2AP110S"
	default n
	help
	  gp2ap110s factory driver.
	  provide sysfs for factory test.
	  request selftest to adsp_factory.
	  receive test result from adsp_factory.

config TMD2636_FACTORY
	tristate "factory test for SSC - TMD2636"
	default n
	help
	  tmd2636 factory driver.
	  provide sysfs for factory test.
	  request selftest to adsp_factory.
	  receive test result from adsp_factory.

config SUPPORT_AK09973
	tristate "Support ak09973"
	default n
	help
	  Support ak09973.

config SAMSUNG_REAR_TOF
	tristate "rear tof camera support"
	default n
	help
        Enables support for rear tof camera.

config SUPPORT_REPORT_HUB_INFO
	tristate "support reporting hub info"
	default n
	help
        Enables support reporting hub info
```

## drivers/platform/galaxyxr/Kconfig
```kconfig
# SPDX-License-Identifier: GPL-2.0-only
menu "Samsung Galaxy XR vendor drivers"
	depends on ARCH_ANORAK && m

config GALAXYXR_AUDIO
	tristate "Qualcomm audio DSP and codecs"
	depends on SND_SOC

config GALAXYXR_DISPLAY
	tristate "Qualcomm SDE and Samsung XR displays"
	depends on DRM && !DRM_MSM

config GALAXYXR_CAMERA
	tristate "Qualcomm Spectra and Samsung cameras"
	depends on VIDEO_V4L2

config GALAXYXR_VIDEO
	tristate "Qualcomm Anorak video codec"
	depends on VIDEO_V4L2

config GALAXYXR_EVA
	tristate "Qualcomm EVA computer vision accelerator"

config GALAXYXR_MMRM
	tristate "Qualcomm multimedia resource manager"

config GALAXYXR_MMRM_TEST
	tristate "Qualcomm multimedia resource manager tests"
	depends on GALAXYXR_MMRM
	default n

config QCA_CLD_WLAN
	tristate "Qualcomm Kiwi v2 WLAN (Samsung profile)"
	depends on WLAN && CFG80211 && CNSS2
	help
	  Build wlan.ko using the supplied kiwi_v2 profile, including
	  Samsung features. This needs the device's existing firmware.

endmenu
```

## kernel_platform/msm-kernel/arch/arm64/Kconfig.projects
```kconfig
config SEC_XRVST2_PROJECT
	depends on ARCH_ANORAK
	default n
	bool "Samsung XRVST2 Project"
	help
	  Support for Samsung XRVST2 Project

menu "Samsung XRVST2"
	depends on SEC_XRVST2_PROJECT
	source "arch/arm64/Kconfig.xrvst2"
endmenu
```

## kernel_platform/msm-kernel/arch/arm64/Kconfig.xrvst2
```kconfig
#
# Samsung XRVST2 Projects
#
config MACH_XRVST2_USA_OPEN
	default n
	bool "Samsung XRVST2 USA OPEN"
	help
	  Support for Samsung XRVST2 USA OPEN device.
```

## kernel_platform/msm-kernel/arch/arm64/configs/vendor/anorak_sec_defconfig
```kconfig
# BSP
CONFIG_SOFT_WATCHDOG=m
CONFIG_SEC_KEY_NOTIFIER=m
CONFIG_SEC_CLASS=m
CONFIG_SEC_PARAM=m
CONFIG_SEC_DEBUG=m
CONFIG_SEC_LOG_BUF=m
CONFIG_SEC_REBOOT_CMD=m
CONFIG_SEC_UPLOAD_CAUSE=m
CONFIG_SEC_CRASHKEY=m
CONFIG_SEC_CRASHKEY_LONG=m
CONFIG_SEC_DEBUG_REGION=m
CONFIG_SEC_PMSG=m
CONFIG_SEC_BOOT_STAT=m
CONFIG_SEC_ARM64_AP_CONTEXT=m
CONFIG_SEC_ARM64_FSIMD_DEBUG=m
CONFIG_SEC_QC_DEBUG=m
CONFIG_SEC_QC_PARAM=m
CONFIG_SEC_QC_LOGGER=m
CONFIG_SEC_QC_QCOM_WDT_CORE=m
CONFIG_SEC_QC_RBCMD=m
CONFIG_SEC_QC_QCOM_REBOOT_REASON=m
CONFIG_SEC_QC_UPLOAD_CAUSE=m
CONFIG_SEC_QC_DEBUG_PARTITION=m
CONFIG_SEC_QC_SUMMARY=m
CONFIG_SEC_QC_USER_RESET=m
CONFIG_SEC_QC_SMEM=m
CONFIG_SEC_QC_HW_PARAM=m
CONFIG_SEC_QC_RST_EXINFO=m
CONFIG_SEC_QC_RDX_BOOTDEV=m
CONFIG_SEC_QC_SOC_ID=m
# Audio
CONFIG_SND_SOC_SAMSUNG_AUDIO=m
CONFIG_SND_SOC_CIRRUS_AMP=m
CONFIG_SND_SOC_CS35L45=m
CONFIG_SND_SOC_CS35L45_I2C=m
#I2C GPIO
CONFIG_I2C_GPIO=y

## IR LED
CONFIG_LEDS_LP8558=m
CONFIG_LEDS_QTI_FLASH=m
CONFIG_LEDS_S2MPB02=m

## ALS
CONFIG_SENSORS_STK6D2X=m

#SVCLED
CONFIG_LEDS_MAX77705_RGB=m
CONFIG_SEC_SVCLED=y

# PM
CONFIG_SEC_PM=y

# PMIC
CONFIG_MFD_S2MPB02=m
CONFIG_REGULATOR_S2MPB02=m
CONFIG_REGULATOR_S2DOS05=m
CONFIG_REGULATOR_S2DOS07=m
CONFIG_DRV_SAMSUNG_PMIC=m
CONFIG_INPUT_KEYLOG=m
CONFIG_SENSORS_SEC_THERMISTOR=m
CONFIG_SEC_PM_LOG=m

# Displayport
CONFIG_SEC_DISPLAYPORT=m
CONFIG_HDCP_QSEECOM=m

# Display
CONFIG_LCD_CLASS_DEVICE=m

CONFIG_HWMON=m

#SEC_FAN
CONFIG_SEC_FAN=m

# BUCK-BOOST REGULATOR
CONFIG_REGULATOR_MAX77720=m
CONFIG_REGULATOR_MAX77816=m
CONFIG_REGULATOR_MAX77816_FAN=m

# FAN Controller IC Driver
CONFIG_SENSORS_MAX31760_SEC_FAN=m

#SLIDER MOTOR
CONFIG_SLIDER_MOTOR=y

# UFS
CONFIG_SEC_UFS_FEATURE=y

# MFD
CONFIG_MFD_MAX77705=m
CONFIG_QCOM_IFPMIC_SUSPEND=y
# CONFIG_ABC_IFPMIC_EVENTis not set
# CONFIG_MAX77705_FW_SEPARATION_PID_BY_MODEL is not set
# CONFIG_MAX77705_USE_EXTRA_FW is not set

# MUIC
CONFIG_USE_MUIC=y
CONFIG_MUIC_NOTIFIER=m
CONFIG_MUIC_HV=y
CONFIG_MUIC_SUPPORT_PDIC=y
CONFIG_HICCUP_CHARGER=y
# CONFIG_USE_SECOND_MUIC is not set
# CONFIG_MUIC_UART_SWITCH is not set
# CONFIG_MUIC_SUPPORT_UART_SEL is not set
# CONFIG_USE_DEDICATED_MUIC is not set
CONFIG_MUIC_AFC_RETRY=y
CONFIG_MUIC_COMMON_SYSFS=y
CONFIG_MUIC_USE_MODULE_PARAM=y
# CONFIG_HICCUP_CC_DISABLE is not set

# STI
CONFIG_SEC_STI=y
# ABC
CONFIG_SEC_ABC=m
CONFIG_SEC_ABC_HUB=m
CONFIG_SEC_ABC_COMMON=m
CONFIG_SEC_ABC_HUB_CORE=m
CONFIG_SEC_ABC_HUB_BOOTC=m
CONFIG_SEC_ABC_SPEC_TYPE1=m

# Switch
CONFIG_SWITCH=m
CONFIG_SWITCH_GPIO=m

# USB NOTIFY
CONFIG_USB_STORAGE_DETECT=y
CONFIG_USB_HOST_NOTIFY=y
CONFIG_USB_NOTIFY_LAYER=m
CONFIG_USB_NOTIFIER=m
CONFIG_USB_EXTERNAL_NOTIFY=y
CONFIG_USB_NOTIFY_PROC_LOG=y
CONFIG_USB_DEBUG_DETAILED_LOG=y
CONFIG_USB_HW_PARAM=y
CONFIG_USB_HOST_SAMSUNG_FEATURE=y

# PDIC
# CONFIG_SUPPORT_USB_TYPEC_OPS=y
CONFIG_CCIC_MAX77705=m
CONFIG_MAXIM_CCIC_ALTERNATE_MODE=y
CONFIG_CCIC_MAX77705_DEBUG=y
CONFIG_MAX77705_FW_PID03_SUPPORT=y
CONFIG_MUIC_MAX77705=m
CONFIG_HV_MUIC_MAX77705_AFC=m
CONFIG_MUIC_MAX77705_PDIC=m
CONFIG_AFC=y
# CONFIG_SUPPORT_QC30 is not set
# CONFIG_MUIC_QC_DISABLE is not set
# CONFIG_UPGRADED_WATER_DETECT is not set
# CONFIG_GET_UNMASK_VBUS_HWPARAM is not set

#s2mm006
CONFIG_PDIC_S2MM006=m
CONFIG_MUIC_S2MM006=m
CONFIG_MUIC_PLATFORM=m
CONFIG_S2MM006_FW_DOWNLOAD=y
CONFIG_S2MM006_POGO=y
CONFIG_MUIC_SUPPORT_POWERMETER=y
CONFIG_MUIC_SUPPORT_PRSWAP=y

# VBUS NOTIFY
CONFIG_VBUS_NOTIFIER=m

# USB TypeC Manager
CONFIG_USB_TYPEC_MANAGER_NOTIFIER=m
CONFIG_IF_CB_MANAGER=m
CONFIG_SBU_SWITCH_CONTROL=y

# USB PDIC common
CONFIG_PDIC_NOTIFIER=m
CONFIG_PDIC_POLICY=y
# CONFIG_USB_ARCH_EXYNOS is not set
CONFIG_PDIC_USE_MODULE_PARAM=y
CONFIG_PDIC_ALTERNATE_MODE=y

#USB
CONFIG_USB_CONFIGFS_ACM=y
CONFIG_USB_CONFIGFS_F_SS_MON_GADGET=m

#Redriver
CONFIG_COMBO_REDRIVER_PS5169=m

## BATTERY
CONFIG_BATTERY_SAMSUNG=m
CONFIG_BATTERY_GKI=y
CONFIG_SEC_PD=m
CONFIG_CHARGER_MAX77705=m
CONFIG_FUELGAUGE_MAX77705=m
CONFIG_SEND_PDMSG_IN_PPS_REQUEST_WORK=y
CONFIG_MFD_MAX17333=m
CONFIG_LIMITER_MAX17333=m

#sensor
CONFIG_SENSORS=y
CONFIG_ADSP_FACTORY=y
CONFIG_LSM6DSV_FACTORY=y
CONFIG_STK3A5X_FACTORY=y
CONFIG_SUPPORT_AK09973=y
CONFIG_A96T3XX_FACTORY=y
CONFIG_SEC_SENSORS_SSC=y
CONFIG_SUPPORT_REPORT_HUB_INFO=y

# Block layer modules
CONFIG_MQ_IOSCHED_SSG=m
CONFIG_MQ_IOSCHED_SSG_CGROUP=m
CONFIG_BLK_SEC_STATS=m

# PCIE
CONFIG_SEC_PCIE=y
CONFIG_SEC_PCIE_AER=y
CONFIG_SEC_PCIE_L1SS=y

# SEC Detecting Connector
CONFIG_SEC_ABC_DETECT_CONN=m

# Touchkey
CONFIG_INPUT_SEC_INPUT=m
CONFIG_KEYBOARD_ABOV_TOUCH_T396=m

# USB
CONFIG_USB_CONFIGFS_F_CONN_GADGET=m

# [ SEC_SELINUX_PORTING_COMMON
CONFIG_EXT4_FS_SECURITY=y
CONFIG_AUDIT=y
CONFIG_LSM_MMAP_MIN_ADDR=4096
CONFIG_SECURITY_SELINUX=y
CONFIG_DEFAULT_SECURITY_SELINUX=y
CONFIG_NETFILTER_ADVANCED=y
CONFIG_NETFILTER_XT_TARGET_LOG=y
CONFIG_SECURITY_SELINUX_DEVELOP=y
CONFIG_AUDITSYSCALL=y
# ] SEC_SELINUX_PORTING_COMMON

# MAX34417 power accumulator
CONFIG_SENSORS_MAX34427=m

# WLAN
CONFIG_CNSS2_DEBUG=n


CONFIG_SAMSUNG_PRODUCT_SHIP=y


# CONFIG_SEC_FACTORY is not set


# CONFIG_SEC_FACTORY_INTERPOSER is not set
```

## kernel_platform/msm-kernel/arch/arm64/configs/vendor/anorak_sec_eng_defconfig
```kconfig
#POWER
CONFIG_SEC_GPIO_DVS=m

# Samsung Eng PCIe PHY Tune
CONFIG_SEC_PCIE_DEV=y

# ABC Hub bootc eng mode
CONFIG_SEC_ABC_HUB_BOOTC_ENG=m

# sec_bsp / sec_debug
CONFIG_SEC_FORCE_ERR=y
```
