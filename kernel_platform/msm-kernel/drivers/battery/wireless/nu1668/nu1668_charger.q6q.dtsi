#include <dt-bindings/battery/sec-battery.h>

&nu_pdrc_default {
	GPIO_CONFIG_PUD(${nu_pdrc_gpio}, FUNC_OUTPUT_HIGH, PULL_NONE);
	power-source = <1>; /* need to set default MV gpio to LV */
};

&nu_det_default {
	power-source = <1>; /* need to set default MV gpio to LV */
};

#if ${feature_use_gpio_mag_det}(get)
&nu_mag_det_default {
	power-source = <1>; /* need to set default MV gpio to LV */
};
#endif

&qupv3_hub_i2c7_pins {
	qupv3_hub_i2c7_sda_active {
		config {
			/delete-property/ bias-pull-up;
			/delete-property/ qcom,i2c_pull;
			bias-disable;
		};
	};
	qupv3_hub_i2c7_scl_active {
		config {
			/delete-property/ bias-pull-up;
			/delete-property/ qcom,i2c_pull;
			bias-disable;
		};
	};
	qupv3_hub_i2c7_sleep {
		config {
			bias-disable;
		};
	};
};

&nu1668_charger {
	battery,pdrc_vrect_clear;
	battery,unknown_cmb_ctrl;
	battery,default_clamp_volt;
	battery,cep_timeout_xac = <900>;
	battery,tx_min_op_freq = <1130>;
	battery,gear_min_op_freq = <1180>;

	fod_list {
		epp_ref_qf = <0x32>;
		epp_ref_rf = <0x70>;

		bpp_vout = <5500>;

		pad_0x00 { /* DEFAULT */
			bpp { /* DEFAULT OP MODE */
				flag = <(SET_FOD_CC(ADD) | SET_FOD_CV(ADD) | SET_FOD_FULL(ADD))>;
				cc = <0x30 0x3C 0x30 0x32 0x35 0x32 0x35 0x2F 0x35 0x2F 0x32 0x32 0x32 0x6C 0x32 0x7C 0x32 0x41 0x32 0x41>;
				cv = <0x30 0x5A 0x30 0x50 0x35 0x50 0x35 0x4D 0x35 0x4D 0x32 0x50 0x32 0x7F 0x32 0x7F 0x32 0x5F 0x32 0x5F>;
				full = <0xFF 0x7F 0xFF 0x7F 0xFF 0x7F 0xFF 0x7F 0xFF 0x7F 0xFF 0x7F 0xFF 0x7F 0xFF 0x7F 0xFF 0x7F 0xFF 0x7F>;
			};

			ppde {
				flag = <(SET_FOD_CC(ADD) | SET_FOD_CV(ADD) | SET_FOD_FULL(ADD))>;
				cc = <0x30 0x3C 0x30 0x32 0x35 0x32 0x35 0x2F 0x35 0x2F 0x32 0x32 0x32 0x6C 0x32 0x7C 0x32 0x41 0x32 0x41>;
				cv = <0x30 0x5A 0x30 0x50 0x35 0x50 0x35 0x4D 0x35 0x4D 0x32 0x50 0x32 0x7F 0x32 0x7F 0x32 0x5F 0x32 0x5F>;
				full = <0xFF 0x7F 0xFF 0x7F 0xFF 0x7F 0xFF 0x7F 0xFF 0x7F 0xFF 0x7F 0xFF 0x7F 0xFF 0x7F 0xFF 0x7F 0xFF 0x7F>;
			};

			epp {
				flag = <(SET_FOD_CC(ADD) | SET_FOD_CV(ADD) | SET_FOD_FULL(ADD))>;
				cc = <0x5A 0x55 0x2D 0x2D 0x2D 0x23 0x2D 0x23 0x2D 0x23 0x48 0x4B 0x43 0x46 0x43 0x46 0x4B 0x4B 0x3C 0x4B>;
				cv = <0x5A 0x73 0x2D 0x4B 0x2D 0x41 0x2D 0x41 0x2D 0x41 0x48 0x69 0x43 0x64 0x43 0x64 0x4B 0x69 0x3C 0x69>;
				full = <0xFF 0x7F 0xFF 0x7F 0xFF 0x7F 0xFF 0x7F 0xFF 0x7F 0xFF 0x7F 0xFF 0x7F 0xFF 0x7F 0xFF 0x7F 0xFF 0x7F>;
			};
		};
	};
};
