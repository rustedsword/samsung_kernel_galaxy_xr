#include <dt-bindings/battery/sec-battery.h>

&nu_pdrc_default {
	GPIO_CONFIG_PUD(${nu_pdrc_gpio}, FUNC_OUTPUT_HIGH, PULL_NONE);
	power-source = <1>; /* need to set default MV gpio to LV */
};

&nu_det_default {
	power-source = <1>; /* need to set default MV gpio to LV */
};

#if ${feature_use_gpio_mag_det}(get)
&nu_mag_det_default {
	power-source = <1>; /* need to set default MV gpio to LV */
};
#endif

&qupv3_hub_i2c7_pins {
	qupv3_hub_i2c7_sda_active {
		config {
			/delete-property/ bias-pull-up;
			/delete-property/ qcom,i2c_pull;
			bias-disable;
		};
	};
	qupv3_hub_i2c7_scl_active {
		config {
			/delete-property/ bias-pull-up;
			/delete-property/ qcom,i2c_pull;
			bias-disable;
		};
	};
	qupv3_hub_i2c7_sleep {
		config {
			bias-disable;
		};
	};
};

&nu1668_charger {
	battery,pdrc_vrect_clear;
	battery,unknown_cmb_ctrl;
	battery,default_clamp_volt;
	battery,cep_timeout_xac = <900>;
	battery,tx_min_op_freq = <1130>;
	battery,gear_min_op_freq = <1180>;

	fod_list {
		epp_ref_qf = <0x26>;
		epp_ref_rf = <0x6C>;

		bpp_vout = <5500>;

		pad_0x00 { /* DEFAULT */
			bpp { /* DEFAULT OP MODE */
				flag = <(SET_FOD_CC(ADD) | SET_FOD_CV(ADD) | SET_FOD_FULL(ADD))>;
				cc = <0x30 0x3C 0x30 0x32 0x35 0x32 0x35 0x26 0x35 0x26 0x32 0x47 0x32 0x6C 0x32 0x7C 0x32 0x41 0x32 0x41>;
				cv = <0x30 0x5A 0x30 0x50 0x35 0x50 0x35 0x44 0x35 0x44 0x32 0x65 0x32 0x7F 0x32 0x7F 0x32 0x5F 0x32 0x5F>;
				full = <0xFF 0x7F 0xFF 0x7F 0xFF 0x7F 0xFF 0x7F 0xFF 0x7F 0xFF 0x7F 0xFF 0x7F 0xFF 0x7F 0xFF 0x7F 0xFF 0x7F>;
			};

			ppde {
				flag = <(SET_FOD_CC(ADD) | SET_FOD_CV(ADD) | SET_FOD_FULL(ADD))>;
				cc = <0x30 0x3C 0x30 0x32 0x35 0x32 0x35 0x26 0x35 0x26 0x32 0x47 0x32 0x6C 0x32 0x7C 0x32 0x41 0x32 0x41>;
				cv = <0x30 0x5A 0x30 0x50 0x35 0x50 0x35 0x44 0x35 0x44 0x32 0x65 0x32 0x7F 0x32 0x7F 0x32 0x5F 0x32 0x5F>;
				full = <0xFF 0x7F 0xFF 0x7F 0xFF 0x7F 0xFF 0x7F 0xFF 0x7F 0xFF 0x7F 0xFF 0x7F 0xFF 0x7F 0xFF 0x7F 0xFF 0x7F>;
			};

			epp {
				flag = <(SET_FOD_CC(ADD) | SET_FOD_CV(ADD) | SET_FOD_FULL(ADD))>;
				cc = <0x90 0x85 0x45 0x45 0x45 0x35 0x45 0x35 0x45 0x35 0x75 0x75 0x75 0x70 0x75 0x70 0x75 0x75 0x60 0x75>;
				cv = <0x90 0x7F 0x45 0x63 0x45 0x53 0x45 0x53 0x45 0x53 0x75 0x7F 0x75 0x7F 0x75 0x7F 0x75 0x7F 0x60 0x7F>;
				full = <0xFF 0x7F 0xFF 0x7F 0xFF 0x7F 0xFF 0x7F 0xFF 0x7F 0xFF 0x7F 0xFF 0x7F 0xFF 0x7F 0xFF 0x7F 0xFF 0x7F>;
			};
		};
	};
};
