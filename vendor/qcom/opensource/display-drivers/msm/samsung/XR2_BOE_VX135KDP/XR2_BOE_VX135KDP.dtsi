/* Copyright (c) 2013-2014, The Linux Foundation. All rights reserved.
 *
 * This program is free software; you can redistribute it and/or modify
 * it under the terms of the GNU General Public License version 2 and
 * only version 2 as published by the Free Software Foundation.
 *
 * This program is distributed in the hope that it will be useful,
 * but WITHOUT ANY WARRANTY; without even the implied warranty of
 * MERCHANTABILITY or FITNESS FOR A PARTICULAR PURPOSE.  See the
 * GNU General Public License for more details.
 */

&mdss_mdp0 {
	XR2_BOE_VX135KDP: XR2_BOE_VX135KDP {
		qcom,mdss-dsi-panel-name = "XR2_BOE_VX135KDP";
		label = "XR2_BOE_VX135KDP";

		qcom,mdss-dsi-bpp = <24>;
		qcom,mdss-dsi-h-left-border = <0>;
		qcom,mdss-dsi-h-right-border = <0>;
		qcom,mdss-dsi-v-top-border = <0>;
		qcom,mdss-dsi-v-bottom-border = <0>;

		qcom,mdss-dsi-underflow-color = <0xFF>;
		qcom,mdss-dsi-border-color = <0>;

		qcom,mdss-dsi-bl-pmic-control-type = "bl_ctrl_dcs";

		qcom,mdss-dsi-interleave-mode = <0>;
		qcom,mdss-dsi-panel-type = "dsi_video_mode";
		qcom,mdss-dsi-force-clock-lane-hs;

		qcom,mdss-dsi-wr-mem-start = <0x2C>;
		qcom,mdss-dsi-wr-mem-continue = <0x3C>;

		qcom,mdss-dsi-bllp-eof-power-mode;
		qcom,mdss-dsi-bllp-power-mode;
		qcom,mdss-dsi-traffic-mode= "non_burst_sync_event";

		qcom,mdss-dsi-pixel-packing = "loose";

		qcom,mdss-dsi-virtual-channel-id = <0>;
		qcom,mdss-dsi-color-order = "rgb_swap_rgb";
		qcom,mdss-dsi-lane-0-state;
		qcom,mdss-dsi-lane-1-state;
		qcom,mdss-dsi-lane-2-state;
		qcom,mdss-dsi-lane-3-state;
		qcom,mdss-dsi-lane-map = "lane_map_0123";

		qcom,mdss-dsi-stream = <0>;
		qcom,mdss-dsi-mdp-trigger = "none";
		qcom,mdss-dsi-dma-trigger = "trigger_sw";

		qcom,mdss-pan-physical-width-dimension = <23>;
		qcom,mdss-pan-physical-height-dimension = <25>;

		qcom,mdss-dsi-panel-mode-gpio-state = "invalid";

		/* temp add to avoid error log */
		qcom,mdss-dsi-reset-sequence = <1 5>, <0 2>, <1 20>;

		qcom,mdss-dsi-init-delay-us = <1000>;
		qcom,mdss-dsi-rx-eot-ignore;

		qcom,mdss-dsi-panel-hdr-enabled;
		qcom,mdss-dsi-panel-hdr-color-primaries = <14880 15935 32435
			16555 14945 30910 7790 3415>;
		qcom,mdss-dsi-panel-peak-brightness = <5643000>;
		qcom,mdss-dsi-panel-average-brightness = <2000000>;
		qcom,mdss-dsi-panel-blackness-level = <6134>;

		qcom,mdss-dsi-bl-min-level = <1>;
		qcom,mdss-dsi-bl-max-level = <255>;
		qcom,mdss-brightness-max-level = <255>;
		qcom,mdss-brightness-default-level = <255>;

/* *************************************************************
 *  Rx (Module Information READ)
 * *************************************************************
 */
		samsung,manufacture_id0_rx_cmds_revA	= [06 01 00 00 00 00 01 DA 01 00];
		samsung,manufacture_id1_rx_cmds_revA	= [06 01 00 00 00 00 01 DB 01 00];
		samsung,manufacture_id2_rx_cmds_revA	= [06 01 00 00 00 00 01 DC 01 00];

		samsung,mtp_read_sysfs_rx_cmds_revA	= [06 01 00 00 00 00 01 00 00 00];
		samsung,mtp_write_sysfs_tx_cmds_revA	= [
			39 00 00 00 00 00 3D 00
						00 00 00 00 00 00 00 00 00 00
						00 00 00 00 00 00 00 00 00 00
						00 00 00 00 00 00 00 00 00 00
						00 00 00 00 00 00 00 00 00 00
						00 00 00 00 00 00 00 00 00 00
						00 00 00 00 00 00 00 00 00 00
		];
/*
 * ************************************************************************************************************************************
 *
 *
 *			Below  parameters are samsung dependent things
 *
 *
 * ************************************************************************************************************************************
 */
		samsung,panel-vendor = "BOE";
		samsung,disp-model = "VX135KDP";
		samsung,support_gamma_mode2;
		samsung,delayed-display-on = <1>;
		samsung,display_on_tx_cmds_revA = [
			39 00 00 00 64 00 01 11
			39 00 00 00 00 00 01 29
		];

		/* BRIGHTNESS_MAX_PACKET = 100 */
		samsung,brightness_tx_cmds_revA = [
			39 00 00 00 00 00 01 00
			39 00 00 00 00 00 01 00
			39 00 00 00 00 00 01 00
			39 00 00 00 00 00 01 00
			39 00 00 00 00 00 01 00
			39 00 00 00 00 00 01 00
			39 00 00 00 00 00 01 00
			39 00 00 00 00 00 01 00
			39 00 00 00 00 00 01 00
			39 00 00 00 00 00 01 00
			39 00 00 00 00 00 01 00
			39 00 00 00 00 00 01 00
			39 00 00 00 00 00 01 00
			39 00 00 00 00 00 01 00
			39 00 00 00 00 00 01 00
			39 00 00 00 00 00 01 00
			39 00 00 00 00 00 01 00
			39 00 00 00 00 00 01 00
			39 00 00 00 00 00 01 00
			39 00 00 00 00 00 01 00
			39 00 00 00 00 00 01 00
			39 00 00 00 00 00 01 00
			39 00 00 00 00 00 01 00
			39 00 00 00 00 00 01 00
			39 00 00 00 00 00 01 00
			39 00 00 00 00 00 01 00
			39 00 00 00 00 00 01 00
			39 00 00 00 00 00 01 00
			39 00 00 00 00 00 01 00
			39 00 00 00 00 00 01 00
			39 00 00 00 00 00 01 00
			39 00 00 00 00 00 01 00
			39 00 00 00 00 00 01 00
			39 00 00 00 00 00 01 00
			39 00 00 00 00 00 01 00
			39 00 00 00 00 00 01 00
			39 00 00 00 00 00 01 00
			39 00 00 00 00 00 01 00
			39 00 00 00 00 00 01 00
			39 00 00 00 00 00 01 00
			39 00 00 00 00 00 01 00
			39 00 00 00 00 00 01 00
			39 00 00 00 00 00 01 00
			39 00 00 00 00 00 01 00
			39 00 00 00 00 00 01 00
			39 00 00 00 00 00 01 00
			39 00 00 00 00 00 01 00
			39 00 00 00 00 00 01 00
			39 00 00 00 00 00 01 00
			39 00 00 00 00 00 01 00
			39 00 00 00 00 00 01 00
			39 00 00 00 00 00 01 00
			39 00 00 00 00 00 01 00
			39 00 00 00 00 00 01 00
			39 00 00 00 00 00 01 00
			39 00 00 00 00 00 01 00
			39 00 00 00 00 00 01 00
			39 00 00 00 00 00 01 00
			39 00 00 00 00 00 01 00
			39 00 00 00 00 00 01 00
			39 00 00 00 00 00 01 00
			39 00 00 00 00 00 01 00
			39 00 00 00 00 00 01 00
			39 00 00 00 00 00 01 00
			39 00 00 00 00 00 01 00
			39 00 00 00 00 00 01 00
			39 00 00 00 00 00 01 00
			39 00 00 00 00 00 01 00
			39 00 00 00 00 00 01 00
			39 00 00 00 00 00 01 00
			39 00 00 00 00 00 01 00
			39 00 00 00 00 00 01 00
			39 00 00 00 00 00 01 00
			39 00 00 00 00 00 01 00
			39 00 00 00 00 00 01 00
			39 00 00 00 00 00 01 00
			39 00 00 00 00 00 01 00
			39 00 00 00 00 00 01 00
			39 00 00 00 00 00 01 00
			39 00 00 00 00 00 01 00
			39 00 00 00 00 00 01 00
			39 00 00 00 00 00 01 00
			39 00 00 00 00 00 01 00
			39 00 00 00 00 00 01 00
			39 00 00 00 00 00 01 00
			39 00 00 00 00 00 01 00
			39 00 00 00 00 00 01 00
			39 00 00 00 00 00 01 00
			39 00 00 00 00 00 01 00
			39 00 00 00 00 00 01 00
			39 00 00 00 00 00 01 00
			39 00 00 00 00 00 01 00
			39 00 00 00 00 00 01 00
			39 00 00 00 00 00 01 00
			39 00 00 00 00 00 01 00
			39 00 00 00 00 00 01 00
			39 00 00 00 00 00 01 00
			39 00 00 00 00 00 01 00
			39 00 00 00 00 00 01 00
			39 00 00 00 00 00 01 00
		];
		samsung,gamma_mode2_normal_tx_cmds_revA = [
			39 00 00 00 00 00 02 FF 00
			39 00 00 00 00 00 02 B0 00
			39 00 00 00 00 00 02 FF 03
			39 00 00 00 00 00 3D B4 
				28 E2 8E 28 E2 8E 28 E2 8E 28 E2 8E 28 E2 8E
				28 E2 8E 28 E2 8E 28 E2 8E 28 E2 8E 28 E2 8E
				28 E2 8E 28 E2 8E 28 E2 8E 28 E2 8E 28 E2 8E
				28 E2 8E 28 E2 8E 28 E2 8E 28 E2 8E 28 E2 8E
		];

		samsung,candela_map_table_revA = < /* THIS TABLE USED FOR DIMMING */
		/* <idx> <from> <till> <gm2_wrdisbv> <cd> */
			0	0	30	831691	200
			1	31	60	1294652	310
			2	61	90	1753516	420
			3	91	120	2216477	530			
			4	121	150	2679438	640
			5	151	180	3183369	760
			6	181	210	3687300	880
			7	211	255	4191231	1000
		>;

		/*
		* ************************************************************************************************************************
		* MULTI_RESOLUTION (DSC configs were moved all to below timing set)
		* (C10P does not support MULTI_RESOLUTION, only FHD.)
		* ************************************************************************************************************************
		*/
#if 1//4K 90

		qcom,mdss-dsi-display-timings {
			4K60 {
				qcom,display-topology = <4 4 2>;
				qcom,default-topology-index = <0>;

				qcom,mdss-dsi-panel-width = <1776>; /* 2544 / 2(intf_num) */
				qcom,mdss-dsi-panel-height = <3840>;

				qcom,mdss-dsi-t-clk-pre = <0x24>;
				qcom,mdss-dsi-t-clk-post = <0x11>;
				qcom,mdss-dsi-panel-phy-timings = [00 2C 0C 0C 1D 26 0C 0C 0B 02 04 00 24 11];
				qcom,mdss-dsi-panel-framerate = <60>;

				qcom,mdss-dsi-h-pulse-width = <1>;
				qcom,mdss-dsi-h-back-porch = <40>;
				qcom,mdss-dsi-h-front-porch = <20>;
				qcom,mdss-dsi-h-sync-skew = <0>;
				qcom,mdss-dsi-v-pulse-width = <1>;
				qcom,mdss-dsi-v-back-porch = <18>;
				qcom,mdss-dsi-v-front-porch = <8>;
//				qcom,mdss-dsi-panel-clockrate = <650000000>;
				qcom,mdss-dsi-on-command = [
					39 00 00 00 00 00 02 B0 00
					39 00 00 00 00 00 59 F5 12
						00 00 89 30 80 0f 00 0d e0 00 18 03 78 03 78 02
						00 02 e1 00 20 02 b9 00 0c 00 0d 04 86 02 94 18
						00 10 f0 03 0c 20 00 06 0b 0b 33 0e 1c 2a 38 46
						54 62 69 70 77 79 7b 7d 7e 01 02 01 00 09 40 09
						be 19 fc 19 fa 19 f8 1a 38 1a 78 1a b6 2a b6 2a
						f4 2a f4 4b 34 63 74
					39 00 00 00 00 00 02 03 01
					39 00 00 00 00 00 03 51 FF FF
					39 00 00 00 00 00 02 65 00
					39 00 00 00 00 00 02 36 03
					39 00 00 00 00 00 02 FF 01
					39 00 00 00 00 00 02 EC 20
					39 00 00 00 00 00 8C BF
						12 16 1a 1e 22 33 32 3a 3b 41 02 06 0a 3d 00 00
						00 00 00 01 00 00 00 46 4a 48 4c 50 4e 00 12 16
						1a 1e 22 33 32 3a 3b 41 02 06 0a 3d 00 00 00 00
						00 01 00 00 00 46 4a 48 4c 50 4e 00 00 00 00 00
						00 00 00 00 00 02 00 00 80 00 00 00 00 02 00 00
						80 00 00 00 ff ff ff ff ff ff ff 0f 00 00 80 1f
						00 00 e0 07 00 00 00 00 00 00 00 00 80 00 00 00
						00 00 00 00 00 00 00 00 00 00 00 00 00 00 00 00
						00 00 00 00 00 00 00 00 00 00 00
					39 00 00 00 00 00 BC B5
						11 11 10 33 33 33 33 33 ff ff ff ff ff ff ff ff
						ff ff f0 01 00 fb 00 00 00 aa fa 1b 03 20 00 40
						00 00 03 10 51 51 10 05 10 04 11 10 05 10 04 10
						06 10 05 11 10 02 10 01 00 00 00 00 10 01 10 01
						00 00 00 00 00 00 00 10 01 10 01 00 00 00 00 00
						00 00 00 10 01 10 01 00 00 00 00 00 00 00 00 10
						01 10 01 00 00 00 00 00 00 00 00 10 01 10 01 00
						00 00 00 00 00 00 10 01 10 01 00 00 00 00 00 00
						00 10 01 10 01 00 00 00 00 00 00 00 10 01 10 01
						00 00 00 00 00 00 00 00 00 02 00 00 02 00 00 02
						00 00 02 00 00 02 00 00 02 00 00 02 00 00 02 00
						00 00 00 00 00 00 00 00 00 00 00
					39 00 00 00 00 00 77 BA
						00 00 00 00 00 00 30 10 00 00 00 00 00 00 00 30
						10 00 00 00 00 00 30 00 14 00 00 00 00 00 00 00
						00 30 10 00 00 00 00 00 00 00 00 00 00 00 00 00
						00 00 00 00 00 00 00 00 00 00 0f 10 00 10 00 00
						00 00 00 43 1F 04 10 00 00 00 00 02 00 00 02 00
						00 02 00 00 02 00 00 02 00 00 02 00 00 02 00 00
						02 00 00 00 00 00 00 00 00 00 00 00 00 00 00 00
						00 00 00 00 00 00
					39 00 00 00 00 00 21 BE
						00 00 00 00 00 07 00 00 00 00 00 00 00 00 00 00
						50 AA AA AA AA AA AA 90 00 AA AA AA AA AA AA 90
					39 00 00 00 00 00 54 C2
						00 00 bc 00 97 00 97 00 00 00 00 00 00 00 00 00
						00 00 00 1f ff 00 5e 00 5e 00 00 1f ff 00 5e 00
						5e 00 aa 00 4b 00 a3 00 ab 00 00 1f ff 00 31 00
						bc 00 0e 00 31 00 0e 00 31 00 00 00 9f 00 00 00
						9f 00 00 1f ff 00 00 1f ff 00 04 00 00 00 5E 00
						5E 00 00
					39 00 00 00 00 00 02 FF 01
					39 00 00 00 00 00 02 F1 43					
					39 00 00 00 00 00 03 BA 43 09
				];

				qcom,mdss-dsi-on-command-state = "dsi_hs_mode";
				qcom,mdss-dsi-off-command=[
					05 01 00 00 00 00 01 28		/* display off */
					05 01 00 00 00 00 01 10		/* sleep in */
				];
				qcom,mdss-dsi-off-command-state = "dsi_hs_mode";
				qcom,compression-mode = "dsc";
				qcom,mdss-dsc-slice-height = <24>;
				qcom,mdss-dsc-slice-width = <888>;
				qcom,mdss-dsc-slice-per-pkt = <1>;
				qcom,mdss-dsc-bit-per-component = <8>;
				qcom,mdss-dsc-bit-per-pixel = <8>;
				qcom,mdss-dsc-version = <0x12>;
				qcom,mdss-dsc-block-prediction-enable;
			};
#elif 1//x1.33 scaler
		qcom,mdss-dsi-display-timings {
			fhd75 {
				qcom,display-topology = <2 2 2>;
				qcom,default-topology-index = <0>;

				qcom,mdss-dsi-panel-width = <1332>; /* 2544 / 2(intf_num) */
				qcom,mdss-dsi-panel-height = <2880>;

				qcom,mdss-dsi-t-clk-pre = <0x17>;
				qcom,mdss-dsi-t-clk-post = <0x0C>;
				qcom,mdss-dsi-panel-phy-timings = [00 1B 07 06 16 21 07 07 07 02 04 00 17 0C];
				qcom,mdss-dsi-panel-framerate = <90>;

				qcom,mdss-dsi-h-pulse-width = <1>;
				qcom,mdss-dsi-h-back-porch = <24>;
				qcom,mdss-dsi-h-front-porch = <28>;
				qcom,mdss-dsi-h-sync-skew = <0>;
				qcom,mdss-dsi-v-pulse-width = <1>;
				qcom,mdss-dsi-v-back-porch = <11>;
				qcom,mdss-dsi-v-front-porch = <24>;
				//qcom,mdss-dsi-panel-clockrate = <510400000>;
				qcom,mdss-dsi-on-command = [
					39 00 00 00 00 00 02 B0 00
					39 00 00 00 00 00 59 F5 12
						00 00 89 30 80 0b 40 0a 68 00 18 05 34 05 34 02
						00 03 d2 00 20 03 19 00 12 00 0d 04 86 01 b8 18
						00 10 f0 03 0c 20 00 06 0b 0b 33 0e 1c 2a 38 46
						54 62 69 70 77 79 7b 7d 7e 01 02 01 00 09 40 09
						be 19 fc 19 fa 19 f8 1a 38 1a 78 1a b6 2a b6 2a
						f4 2a f4 4b 34 63 74
					39 00 00 00 00 00 02 03 01
					39 00 00 00 00 00 03 51 FF FF
					39 00 00 00 00 00 02 65 90
					39 00 00 00 00 00 02 36 03
					39 00 00 00 00 00 02 FF 01
					39 00 00 00 00 00 02 EC 20
					39 00 00 00 00 00 8C BF
						12 16 1a 1e 22 33 32 3a 3b 41 02 06 0a 3d 00 00
						00 00 00 01 00 00 00 46 4a 48 4c 50 4e 00 12 16
						1a 1e 22 33 32 3a 3b 41 02 06 0a 3d 00 00 00 00
						00 01 00 00 00 46 4a 48 4c 50 4e 00 00 00 00 00
						00 00 00 00 00 02 00 00 80 00 00 00 00 02 00 00
						80 00 00 00 ff ff ff ff ff ff ff 0f 00 00 80 1f
						00 00 e0 07 00 00 00 00 00 00 00 00 80 00 00 00
						00 00 00 00 00 00 00 00 00 00 00 00 00 00 00 00
						00 00 00 00 00 00 00 00 00 00 00
					39 00 00 00 00 00 BC B5
						11 11 10 33 33 33 33 33 ff ff ff ff ff ff ff ff
						ff ff f0 01 00 fb 00 00 00 aa fa 1b 03 20 00 40
						00 00 03 10 51 51 10 05 10 04 11 10 05 10 04 10
						06 10 05 11 10 02 10 01 00 00 00 00 10 01 10 01
						00 00 00 00 00 00 00 10 01 10 01 00 00 00 00 00
						00 00 00 10 01 10 01 00 00 00 00 00 00 00 00 10
						01 10 01 00 00 00 00 00 00 00 00 10 01 10 01 00
						00 00 00 00 00 00 10 01 10 01 00 00 00 00 00 00
						00 10 01 10 01 00 00 00 00 00 00 00 10 01 10 01
						00 00 00 00 00 00 00 00 00 02 00 00 02 00 00 02
						00 00 02 00 00 02 00 00 02 00 00 02 00 00 02 00
						00 00 00 00 00 00 00 00 00 00 00
					39 00 00 00 00 00 77 BA
						00 00 00 00 00 00 30 10 00 00 00 00 00 00 00 30
						10 00 00 00 00 00 30 00 14 00 00 00 00 00 00 00
						00 30 10 00 00 00 00 00 00 00 00 00 00 00 00 00
						00 00 00 00 00 00 00 00 00 00 0f 10 00 10 00 00
						00 00 00 43 1F 04 10 00 00 00 00 02 00 00 02 00
						00 02 00 00 02 00 00 02 00 00 02 00 00 02 00 00
						02 00 00 00 00 00 00 00 00 00 00 00 00 00 00 00
						00 00 00 00 00 00
					39 00 00 00 00 00 21 BE
						00 00 00 00 00 07 00 00 00 00 00 00 00 00 00 00
						50 AA AA AA AA AA AA 90 00 AA AA AA AA AA AA 90
					39 00 00 00 00 00 54 C2
						00 00 bc 00 97 00 97 00 00 00 00 00 00 00 00 00
						00 00 00 1f ff 00 5e 00 5e 00 00 1f ff 00 5e 00
						5e 00 aa 00 4b 00 a3 00 ab 00 00 1f ff 00 31 00
						bc 00 0e 00 31 00 0e 00 31 00 00 00 9f 00 00 00
						9f 00 00 1f ff 00 00 1f ff 00 04 00 00 00 5E 00
						5E 00 00
					39 00 00 00 00 00 02 FF 01
					39 00 00 00 00 00 02 F1 43					
					39 00 00 00 00 00 03 BA 43 09
				];

				qcom,mdss-dsi-on-command-state = "dsi_hs_mode";
				qcom,mdss-dsi-off-command=[
					05 01 00 00 00 00 01 28		/* display off */
					05 01 00 00 00 00 01 10		/* sleep in */
				];
				qcom,mdss-dsi-off-command-state = "dsi_hs_mode";
				qcom,compression-mode = "dsc";
				qcom,mdss-dsc-slice-height = <24>;
				qcom,mdss-dsc-slice-width = <1332>;
				qcom,mdss-dsc-slice-per-pkt = <2>;
				qcom,mdss-dsc-bit-per-component = <8>;
				qcom,mdss-dsc-bit-per-pixel = <8>;
				qcom,mdss-dsc-version = <0x12>;
				qcom,mdss-dsc-block-prediction-enable;
			};
#else//x2 scaler
		qcom,mdss-dsi-display-timings {
			fhd75 {
				qcom,display-topology = <2 2 2>;
				qcom,default-topology-index = <0>;

				qcom,mdss-dsi-panel-width = <888>; /* 2544 / 2(intf_num) */
				qcom,mdss-dsi-panel-height = <1920>;

				qcom,mdss-dsi-t-clk-pre = <0x13>;
				qcom,mdss-dsi-t-clk-post = <0x0B>;
				qcom,mdss-dsi-panel-phy-timings = [00 16 05 05 14 1F 06 06 06 02 04 00 13 0B];
				qcom,mdss-dsi-panel-framerate = <90>;

				qcom,mdss-dsi-h-pulse-width = <1>;
				qcom,mdss-dsi-h-back-porch = <160>;
				qcom,mdss-dsi-h-front-porch = <160>;
				qcom,mdss-dsi-h-sync-skew = <0>;
				qcom,mdss-dsi-v-pulse-width = <1>;
				qcom,mdss-dsi-v-back-porch = <6>;
				qcom,mdss-dsi-v-front-porch = <17>;
				//qcom,mdss-dsi-panel-clockrate = <510400000>;
				qcom,mdss-dsi-on-command = [
					39 00 00 00 00 00 02 B0 00
					39 00 00 00 00 00 02 03 01
					39 00 00 00 00 00 03 51 FF FF
					39 00 00 00 00 00 02 65 B0
					39 00 00 00 00 00 02 36 03
					39 00 00 00 00 00 02 FF 01
					39 00 00 00 00 00 02 EC 20
					39 00 00 00 00 00 8C BF
						12 16 1a 1e 22 33 32 3a 3b 41 02 06 0a 3d 00 00
						00 00 00 01 00 00 00 46 4a 48 4c 50 4e 00 12 16
						1a 1e 22 33 32 3a 3b 41 02 06 0a 3d 00 00 00 00
						00 01 00 00 00 46 4a 48 4c 50 4e 00 00 00 00 00
						00 00 00 00 00 02 00 00 80 00 00 00 00 02 00 00
						80 00 00 00 ff ff ff ff ff ff ff 0f 00 00 80 1f
						00 00 e0 07 00 00 00 00 00 00 00 00 80 00 00 00
						00 00 00 00 00 00 00 00 00 00 00 00 00 00 00 00
						00 00 00 00 00 00 00 00 00 00 00
					39 00 00 00 00 00 02 FF 00
					39 00 00 00 00 00 02 BA 64
					39 00 00 00 00 00 02 FF 03
					39 00 00 00 00 00 3D B4 
						3F F3 FF 3F F3 FF 3F F3 FF 3F F3 FF 3F F3 FF
						3F F3 FF 3F F3 FF 3F F3 FF 3F F3 FF 3F F3 FF
						3F F3 FF 3F F3 FF 3F F3 FF 3F F3 FF 3F F3 FF
						3F F3 FF 3F F3 FF 3F F3 FF 3F F3 FF 3F F3 FF
				];

				qcom,mdss-dsi-on-command-state = "dsi_hs_mode";
				qcom,mdss-dsi-off-command=[
					05 01 00 00 00 00 01 28		/* display off */
					05 01 00 00 00 00 01 10		/* sleep in */
				];
				qcom,mdss-dsi-off-command-state = "dsi_hs_mode";
				qcom,compression-mode = "dsc";
				qcom,mdss-dsc-encoders = <2>;
				qcom,mdss-dsc-slice-height = <24>;
				qcom,mdss-dsc-slice-width = <888>;
				qcom,mdss-dsc-slice-per-pkt = <1>;
				qcom,mdss-dsc-bit-per-component = <8>;
				qcom,mdss-dsc-bit-per-pixel = <8>;
				qcom,mdss-dsc-version = <0x12>;
//				qcom,mdss-dsc-block-prediction-enable;
			};
#endif
		};
	};
};
