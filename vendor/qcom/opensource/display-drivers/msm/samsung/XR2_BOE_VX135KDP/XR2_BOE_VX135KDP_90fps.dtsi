/* Copyright (c) 2013-2014, The Linux Foundation. All rights reserved.
 *
 * This program is free software; you can redistribute it and/or modify
 * it under the terms of the GNU General Public License version 2 and
 * only version 2 as published by the Free Software Foundation.
 *
 * This program is distributed in the hope that it will be useful,
 * but WITHOUT ANY WARRANTY; without even the implied warranty of
 * MERCHANTABILITY or FITNESS FOR A PARTICULAR PURPOSE.  See the
 * GNU General Public License for more details.
 */

&mdss_mdp0 {
	XR2_BOE_VX135KDP: XR2_BOE_VX135KDP {
		qcom,mdss-dsi-display-timings {
			4K60 {
				qcom,display-topology = <4 4 2>;
				qcom,default-topology-index = <0>;

				qcom,mdss-dsi-panel-width = <1776>; /* 2544 / 2(intf_num) */
				qcom,mdss-dsi-panel-height = <3840>;

				qcom,mdss-dsi-t-clk-pre = <0x24>;
				qcom,mdss-dsi-t-clk-post = <0x11>;
				qcom,mdss-dsi-panel-phy-timings = [00 2C 0C 0C 1D 26 0C 0C 0B 02 04 00 24 11];
				qcom,mdss-dsi-panel-framerate = <90>;

				qcom,mdss-dsi-h-pulse-width = <1>;
				qcom,mdss-dsi-h-back-porch = <40>;
				qcom,mdss-dsi-h-front-porch = <20>;
				qcom,mdss-dsi-h-sync-skew = <0>;
				qcom,mdss-dsi-v-pulse-width = <1>;
				qcom,mdss-dsi-v-back-porch = <18>;
				qcom,mdss-dsi-v-front-porch = <8>;
//				qcom,mdss-dsi-panel-clockrate = <650000000>;
				qcom,mdss-dsi-on-command = [
					39 00 00 00 00 00 02 B0 00
					39 00 00 00 00 00 59 F5 12
						00 00 89 30 80 0f 00 0d e0 00 18 03 78 03 78 02
						00 02 e1 00 20 02 b9 00 0c 00 0d 04 86 02 94 18
						00 10 f0 03 0c 20 00 06 0b 0b 33 0e 1c 2a 38 46
						54 62 69 70 77 79 7b 7d 7e 01 02 01 00 09 40 09
						be 19 fc 19 fa 19 f8 1a 38 1a 78 1a b6 2a b6 2a
						f4 2a f4 4b 34 63 74
					39 00 00 00 00 00 02 03 01
					39 00 00 00 00 00 03 51 FF FF
					39 00 00 00 00 00 02 65 00
					39 00 00 00 00 00 02 36 03
					39 00 00 00 00 00 02 FF 01
					39 00 00 00 00 00 02 EC 20
					39 00 00 00 00 00 8C BF
						12 16 1a 1e 22 33 32 3a 3b 41 02 06 0a 3d 00 00
						00 00 00 01 00 00 00 46 4a 48 4c 50 4e 00 12 16
						1a 1e 22 33 32 3a 3b 41 02 06 0a 3d 00 00 00 00
						00 01 00 00 00 46 4a 48 4c 50 4e 00 00 00 00 00
						00 00 00 00 00 02 00 00 80 00 00 00 00 02 00 00
						80 00 00 00 ff ff ff ff ff ff ff 0f 00 00 80 1f
						00 00 e0 07 00 00 00 00 00 00 00 00 80 00 00 00
						00 00 00 00 00 00 00 00 00 00 00 00 00 00 00 00
						00 00 00 00 00 00 00 00 00 00 00
					39 00 00 00 00 00 BC B5
						11 11 10 33 33 33 33 33 ff ff ff ff ff ff ff ff
						ff ff f0 01 00 fb 00 00 00 aa fa 1b 03 20 00 40
						00 00 03 10 51 51 10 05 10 04 11 10 05 10 04 10
						06 10 05 11 10 02 10 01 00 00 00 00 10 01 10 01
						00 00 00 00 00 00 00 10 01 10 01 00 00 00 00 00
						00 00 00 10 01 10 01 00 00 00 00 00 00 00 00 10
						01 10 01 00 00 00 00 00 00 00 00 10 01 10 01 00
						00 00 00 00 00 00 10 01 10 01 00 00 00 00 00 00
						00 10 01 10 01 00 00 00 00 00 00 00 10 01 10 01
						00 00 00 00 00 00 00 00 00 02 00 00 02 00 00 02
						00 00 02 00 00 02 00 00 02 00 00 02 00 00 02 00
						00 00 00 00 00 00 00 00 00 00 00
					39 00 00 00 00 00 77 BA
						00 00 00 00 00 00 30 10 00 00 00 00 00 00 00 30
						10 00 00 00 00 00 30 00 14 00 00 00 00 00 00 00
						00 30 10 00 00 00 00 00 00 00 00 00 00 00 00 00
						00 00 00 00 00 00 00 00 00 00 0f 10 00 10 00 00
						00 00 00 43 1F 04 10 00 00 00 00 02 00 00 02 00
						00 02 00 00 02 00 00 02 00 00 02 00 00 02 00 00
						02 00 00 00 00 00 00 00 00 00 00 00 00 00 00 00
						00 00 00 00 00 00
					39 00 00 00 00 00 21 BE
						00 00 00 00 00 07 00 00 00 00 00 00 00 00 00 00
						50 AA AA AA AA AA AA 90 00 AA AA AA AA AA AA 90
					39 00 00 00 00 00 54 C2
						00 00 bc 00 97 00 97 00 00 00 00 00 00 00 00 00
						00 00 00 1f ff 00 5e 00 5e 00 00 1f ff 00 5e 00
						5e 00 aa 00 4b 00 a3 00 ab 00 00 1f ff 00 31 00
						bc 00 0e 00 31 00 0e 00 31 00 00 00 9f 00 00 00
						9f 00 00 1f ff 00 00 1f ff 00 04 00 00 00 5E 00
						5E 00 00
					39 00 00 00 00 00 02 FF 01
					39 00 00 00 00 00 02 F1 43					
					39 00 00 00 00 00 03 BA 43 09
				];

				qcom,mdss-dsi-on-command-state = "dsi_hs_mode";
				qcom,mdss-dsi-off-command=[
					05 01 00 00 00 00 01 28		/* display off */
					05 01 00 00 00 00 01 10		/* sleep in */
				];
				qcom,mdss-dsi-off-command-state = "dsi_hs_mode";
				qcom,compression-mode = "dsc";
				qcom,mdss-dsc-slice-height = <24>;
				qcom,mdss-dsc-slice-width = <888>;
				qcom,mdss-dsc-slice-per-pkt = <1>;
				qcom,mdss-dsc-bit-per-component = <8>;
				qcom,mdss-dsc-bit-per-pixel = <8>;
				qcom,mdss-dsc-version = <0x12>;
				qcom,mdss-dsc-block-prediction-enable;
			};
		};
	};
};
