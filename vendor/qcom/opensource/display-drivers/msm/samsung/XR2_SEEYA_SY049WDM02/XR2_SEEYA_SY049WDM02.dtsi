/* Copyright (c) 2013-2014, The Linux Foundation. All rights reserved.
 *
 * This program is free software; you can redistribute it and/or modify
 * it under the terms of the GNU General Public License version 2 and
 * only version 2 as published by the Free Software Foundation.
 *
 * This program is distributed in the hope that it will be useful,
 * but WITHOUT ANY WARRANTY; without even the implied warranty of
 * MERCHANTABILITY or FITNESS FOR A PARTICULAR PURPOSE.  See the
 * GNU General Public License for more details.
 */

&mdss_mdp0 {
	XR2_SEEYA_SY049WDM02: XR2_SEEYA_SY049WDM02 {
		qcom,mdss-dsi-panel-name = "XR2_SEEYA_SY049WDM02";
		label = "XR2_SEEYA_SY049WDM02";

		qcom,mdss-dsi-bpp = <24>;
		qcom,mdss-dsi-h-left-border = <0>;
		qcom,mdss-dsi-h-right-border = <0>;
		qcom,mdss-dsi-v-top-border = <0>;
		qcom,mdss-dsi-v-bottom-border = <0>;

		qcom,mdss-dsi-underflow-color = <0xFF>;
		qcom,mdss-dsi-border-color = <0>;

		qcom,mdss-dsi-bl-pmic-control-type = "bl_ctrl_dcs";

		qcom,mdss-dsi-interleave-mode = <0>;
		qcom,mdss-dsi-panel-type = "dsi_video_mode";
		qcom,mdss-dsi-force-clock-lane-hs;

		qcom,mdss-dsi-wr-mem-start = <0x2C>;
		qcom,mdss-dsi-wr-mem-continue = <0x3C>;

		qcom,mdss-dsi-bllp-eof-power-mode;
		qcom,mdss-dsi-bllp-power-mode;
		qcom,mdss-dsi-traffic-mode= "non_burst_sync_pulse";

		qcom,mdss-dsi-pixel-packing = "loose";

		qcom,mdss-dsi-virtual-channel-id = <0>;
		qcom,mdss-dsi-color-order = "rgb_swap_rgb";
		qcom,mdss-dsi-lane-0-state;
		qcom,mdss-dsi-lane-1-state;
		qcom,mdss-dsi-lane-2-state;
		qcom,mdss-dsi-lane-3-state;
		qcom,mdss-dsi-lane-map = "lane_map_0123";

		qcom,mdss-dsi-stream = <0>;
		qcom,mdss-dsi-mdp-trigger = "none";
		qcom,mdss-dsi-dma-trigger = "trigger_sw";

		qcom,mdss-pan-physical-width-dimension = <18>;
		qcom,mdss-pan-physical-height-dimension = <18>;

		qcom,mdss-dsi-panel-mode-gpio-state = "invalid";

		/* temp add to avoid error log */
		qcom,mdss-dsi-reset-sequence = <1 5>, <0 2>, <1 20>;

		qcom,mdss-dsi-init-delay-us = <1000>;
		qcom,mdss-dsi-rx-eot-ignore;

		qcom,mdss-dsi-panel-hdr-enabled;
		qcom,mdss-dsi-panel-hdr-color-primaries = <14880 15935 32435
			16555 14945 30910 7790 3415>;
		qcom,mdss-dsi-panel-peak-brightness = <5643000>;
		qcom,mdss-dsi-panel-average-brightness = <2000000>;
		qcom,mdss-dsi-panel-blackness-level = <6134>;

		qcom,mdss-dsi-bl-min-level = <1>;
		qcom,mdss-dsi-bl-max-level = <1023>;
		qcom,mdss-brightness-max-level = <1023>;
		qcom,mdss-brightness-default-level = <1023>;

/* *************************************************************
 *  Rx (Module Information READ)
 * *************************************************************
 */
		samsung,manufacture_id0_rx_cmds_revA	= [06 01 00 00 00 00 01 DA 01 00];
		samsung,manufacture_id1_rx_cmds_revA	= [06 01 00 00 00 00 01 DB 01 00];
		samsung,manufacture_id2_rx_cmds_revA	= [06 01 00 00 00 00 01 DC 01 00];

		samsung,mtp_read_sysfs_rx_cmds_revA	= [06 01 00 00 00 00 01 00 00 00];
		samsung,mtp_write_sysfs_tx_cmds_revA	= [
			29 00 00 00 00 00 3D 00
						00 00 00 00 00 00 00 00 00 00
						00 00 00 00 00 00 00 00 00 00
						00 00 00 00 00 00 00 00 00 00
						00 00 00 00 00 00 00 00 00 00
						00 00 00 00 00 00 00 00 00 00
						00 00 00 00 00 00 00 00 00 00
		];
/*
 * ************************************************************************************************************************************
 *
 *
 *			Below  parameters are samsung dependent things
 *
 *
 * ************************************************************************************************************************************
 */
		samsung,panel-vendor = "SEEYA";
		samsung,disp-model = "SY049WDM02";
		samsung,support_gamma_mode2;

		/* BRIGHTNESS_MAX_PACKET = 100 */
		samsung,brightness_tx_cmds_revA = [
			39 00 00 00 00 00 01 00
			39 00 00 00 00 00 01 00
			39 00 00 00 00 00 01 00
			39 00 00 00 00 00 01 00
			39 00 00 00 00 00 01 00
			39 00 00 00 00 00 01 00
			39 00 00 00 00 00 01 00
			39 00 00 00 00 00 01 00
			39 00 00 00 00 00 01 00
			39 00 00 00 00 00 01 00
			39 00 00 00 00 00 01 00
			39 00 00 00 00 00 01 00
			39 00 00 00 00 00 01 00
			39 00 00 00 00 00 01 00
			39 00 00 00 00 00 01 00
			39 00 00 00 00 00 01 00
			39 00 00 00 00 00 01 00
			39 00 00 00 00 00 01 00
			39 00 00 00 00 00 01 00
			39 00 00 00 00 00 01 00
			39 00 00 00 00 00 01 00
			39 00 00 00 00 00 01 00
			39 00 00 00 00 00 01 00
			39 00 00 00 00 00 01 00
			39 00 00 00 00 00 01 00
			39 00 00 00 00 00 01 00
			39 00 00 00 00 00 01 00
			39 00 00 00 00 00 01 00
			39 00 00 00 00 00 01 00
			39 00 00 00 00 00 01 00
			39 00 00 00 00 00 01 00
			39 00 00 00 00 00 01 00
			39 00 00 00 00 00 01 00
			39 00 00 00 00 00 01 00
			39 00 00 00 00 00 01 00
			39 00 00 00 00 00 01 00
			39 00 00 00 00 00 01 00
			39 00 00 00 00 00 01 00
			39 00 00 00 00 00 01 00
			39 00 00 00 00 00 01 00
			39 00 00 00 00 00 01 00
			39 00 00 00 00 00 01 00
			39 00 00 00 00 00 01 00
			39 00 00 00 00 00 01 00
			39 00 00 00 00 00 01 00
			39 00 00 00 00 00 01 00
			39 00 00 00 00 00 01 00
			39 00 00 00 00 00 01 00
			39 00 00 00 00 00 01 00
			39 00 00 00 00 00 01 00
			39 00 00 00 00 00 01 00
			39 00 00 00 00 00 01 00
			39 00 00 00 00 00 01 00
			39 00 00 00 00 00 01 00
			39 00 00 00 00 00 01 00
			39 00 00 00 00 00 01 00
			39 00 00 00 00 00 01 00
			39 00 00 00 00 00 01 00
			39 00 00 00 00 00 01 00
			39 00 00 00 00 00 01 00
			39 00 00 00 00 00 01 00
			39 00 00 00 00 00 01 00
			39 00 00 00 00 00 01 00
			39 00 00 00 00 00 01 00
			39 00 00 00 00 00 01 00
			39 00 00 00 00 00 01 00
			39 00 00 00 00 00 01 00
			39 00 00 00 00 00 01 00
			39 00 00 00 00 00 01 00
			39 00 00 00 00 00 01 00
			39 00 00 00 00 00 01 00
			39 00 00 00 00 00 01 00
			39 00 00 00 00 00 01 00
			39 00 00 00 00 00 01 00
			39 00 00 00 00 00 01 00
			39 00 00 00 00 00 01 00
			39 00 00 00 00 00 01 00
			39 00 00 00 00 00 01 00
			39 00 00 00 00 00 01 00
			39 00 00 00 00 00 01 00
			39 00 00 00 00 00 01 00
			39 00 00 00 00 00 01 00
			39 00 00 00 00 00 01 00
			39 00 00 00 00 00 01 00
			39 00 00 00 00 00 01 00
			39 00 00 00 00 00 01 00
			39 00 00 00 00 00 01 00
			39 00 00 00 00 00 01 00
			39 00 00 00 00 00 01 00
			39 00 00 00 00 00 01 00
			39 00 00 00 00 00 01 00
			39 00 00 00 00 00 01 00
			39 00 00 00 00 00 01 00
			39 00 00 00 00 00 01 00
			39 00 00 00 00 00 01 00
			39 00 00 00 00 00 01 00
			39 00 00 00 00 00 01 00
			39 00 00 00 00 00 01 00
			39 00 00 00 00 00 01 00
			39 00 00 00 00 00 01 00
		];

		samsung,gamma_mode2_normal_tx_cmds_revA = [
			29 00 00 00 00 00 03 F0 AA 11	/* CMD2 P1 */
			29 00 00 00 00 00 07 C2 01 66 01 66 01 66	/* EM=100%*/
		];

		samsung,candela_map_table_revA = < /* THIS TABLE USED FOR DIMMING */
		/* <idx> <from> <till> <gm2_wrdisbv> <cd> */
			0	0	49	71	10
			1	50	99	143	20
			2	100	149	214	30
			3	150	199	286	40
			4	200	255	358	50
		>;

		/*
		* ************************************************************************************************************************
		* MULTI_RESOLUTION (DSC configs were moved all to below timing set)
		* (C10P does not support MULTI_RESOLUTION, only FHD.)
		* ************************************************************************************************************************
		*/
		qcom,mdss-dsi-display-timings {
			fhd75 {
				qcom,display-topology = <2 2 2>;
				qcom,default-topology-index = <0>;

				qcom,mdss-dsi-panel-width = <1272>; /* 2544 / 2(intf_num) */
				qcom,mdss-dsi-panel-height = <2544>;

				qcom,mdss-dsi-t-clk-pre = <0x14>;
				qcom,mdss-dsi-t-clk-post = <0x0B>;
				qcom,mdss-dsi-panel-phy-timings = [00 16 06 05 14 1F 06 06 06 02 04 00 14 0B];
				qcom,mdss-dsi-panel-framerate = <75>;

				qcom,mdss-dsi-h-pulse-width = <32>;
				qcom,mdss-dsi-h-back-porch = <32>;
				qcom,mdss-dsi-h-front-porch = <64>;
				qcom,mdss-dsi-h-sync-skew = <0>;
				qcom,mdss-dsi-v-pulse-width = <2>;
				qcom,mdss-dsi-v-back-porch = <14>;
				qcom,mdss-dsi-v-front-porch = <16>;
				//qcom,mdss-dsi-panel-clockrate = <510400000>;
				qcom,mdss-dsi-on-command = [

					29 00 00 00 00 00 02 03 81
					29 00 00 00 00 00 02 53 29
					29 00 00 00 00 00 03 51 FF 01
					29 00 00 00 00 00 02 69 00
					29 00 00 00 00 00 02 6B 10
					29 00 00 00 00 00 02 36 03

					29 00 00 00 00 00 2D 70
						11 00 00 89 30 80 09 F0
						04 F8 00 18 04 F8 04 F8
						02 00 03 7C 00 20 03 3D
						00 11 00 0C 04 2D 01 CD
						18 00 10 F0 03 0C 20 00
						06 0B 0B 33

					29 00 00 00 00 00 05 80 01 3E 3E 11
					29 00 00 00 00 00 08 81 01 E1 00 10 00 10 00
					29 00 00 00 00 00 08 82 01 E1 00 10 00 10 00
					29 00 00 00 00 00 02 25 01
					29 00 00 00 00 00 03 2A 00 08
					29 00 00 00 00 00 03 2B 00 08

					/* CMD2 P0 */
					29 00 00 00 00 00 03 F0 AA 10
					29 00 00 00 00 00 02 D1 02

					/* CMD2 P1 */
					29 00 00 00 00 00 03 F0 AA 11
					29 00 00 00 00 00 0A C2 01 66 01 66 01 66 00 90 02

					/* CMD2 P2 */
					29 00 00 00 00 00 03 F0 AA 12
					29 00 00 00 00 00 02 D3 20
					29 00 00 00 00 00 03 BF 07 BE

					/* CMD3 P1 */
					29 00 00 00 00 00 03 FF 5A 81
					29 00 00 00 00 00 02 65 0B
					29 00 00 00 14 00 0E F9		/* delay_ms(20) */
						58 5F 66 6D 74 7B 82 89
						90 97 9E A5 AC

					05 00 00 00 64 00 01 11		/* delay_ms(100) */

					05 00 00 00 14 00 01 29 	/* delay_ms(20) */
					29 00 00 00 00 00 03 F0 AA 11
					29 00 00 00 00 00 02 C0 FF
				];

				qcom,mdss-dsi-on-command-state = "dsi_hs_mode";
				qcom,mdss-dsi-off-command=[
					05 01 00 00 00 00 01 28		/* display off */
					05 01 00 00 00 00 01 10		/* sleep in */
				];
				qcom,mdss-dsi-off-command-state = "dsi_hs_mode";
				qcom,compression-mode = "dsc";
				qcom,mdss-dsc-encoders = <2>;
				qcom,mdss-dsc-slice-height = <24>;
				qcom,mdss-dsc-slice-width = <1272>;
				qcom,mdss-dsc-slice-per-pkt = <1>;
				qcom,mdss-dsc-bit-per-component = <8>;
				qcom,mdss-dsc-bit-per-pixel = <8>;
				qcom,mdss-dsc-block-prediction-enable;
			};
		};
	};
};
