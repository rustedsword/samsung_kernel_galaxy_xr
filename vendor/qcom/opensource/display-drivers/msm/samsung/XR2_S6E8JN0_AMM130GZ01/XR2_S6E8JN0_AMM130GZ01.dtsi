/* Copyright (c) 2013-2014, The Linux Foundation. All rights reserved.
 *
 * This program is free software; you can redistribute it and/or modify
 * it under the terms of the GNU General Public License version 2 and
 * only version 2 as published by the Free Software Foundation.
 *
 * This program is distributed in the hope that it will be useful,
 * but WITHOUT ANY WARRANTY; without even the implied warranty of
 * MERCHANTABILITY or FITNESS FOR A PARTICULAR PURPOSE.  See the
 * GNU General Public License for more details.
 */

&mdss_mdp0 {
	XR2_S6E8JN0_AMM130GZ01: XR2_S6E8JN0_AMM130GZ01 {
		qcom,mdss-dsi-panel-name = "XR2_S6E8JN0_AMM130GZ01";
		label = "XR2_S6E8JN0_AMM130GZ01";

		qcom,mdss-dsi-bpp = <24>;
		qcom,mdss-dsi-h-left-border = <0>;
		qcom,mdss-dsi-h-right-border = <0>;
		qcom,mdss-dsi-v-top-border = <0>;
		qcom,mdss-dsi-v-bottom-border = <0>;

		qcom,mdss-dsi-underflow-color = <0xFF>;
		qcom,mdss-dsi-border-color = <0>;

		qcom,mdss-dsi-bl-pmic-control-type = "bl_ctrl_dcs";

		qcom,mdss-dsi-interleave-mode = <0>;
		qcom,mdss-dsi-panel-type = "dsi_video_mode";
		qcom,mdss-dsi-wr-mem-start = <0x2C>;
		qcom,mdss-dsi-wr-mem-continue = <0x3C>;

		qcom,mdss-dsi-bllp-eof-power-mode;
		qcom,mdss-dsi-bllp-power-mode;
		qcom,mdss-dsi-traffic-mode= "non_burst_sync_event";

		qcom,mdss-dsi-pixel-packing = "loose";

		qcom,mdss-dsi-virtual-channel-id = <0>;
		qcom,mdss-dsi-color-order = "rgb_swap_rgb";
		qcom,mdss-dsi-lane-0-state;
		qcom,mdss-dsi-lane-1-state;
		qcom,mdss-dsi-lane-2-state;
		qcom,mdss-dsi-lane-3-state;
		qcom,mdss-dsi-lane-map = "lane_map_0123";

		qcom,mdss-dsi-stream = <0>;
		qcom,mdss-dsi-mdp-trigger = "none";
		qcom,mdss-dsi-dma-trigger = "trigger_sw";

		qcom,mdss-pan-physical-width-dimension = <23>;
		qcom,mdss-pan-physical-height-dimension = <25>;

		qcom,mdss-dsi-panel-mode-gpio-state = "invalid";

		/* temp add to avoid error log */
		qcom,mdss-dsi-reset-sequence = <1 5>, <0 2>, <1 20>;

		qcom,mdss-dsi-init-delay-us = <1000>;
		qcom,mdss-dsi-rx-eot-ignore;

		qcom,mdss-dsi-panel-hdr-enabled;
		qcom,mdss-dsi-panel-hdr-color-primaries = <14880 15935 32435
			16555 14945 30910 7790 3415>;
		qcom,mdss-dsi-panel-peak-brightness = <5643000>;
		qcom,mdss-dsi-panel-average-brightness = <2000000>;
		qcom,mdss-dsi-panel-blackness-level = <6134>;

		qcom,esd-check-enabled;
		qcom,mdss-dsi-panel-status-check-mode ="irq_check";
		samsung,esd-irq-trigger1 = "falling";

		qcom,mdss-dsi-bl-min-level = <1>;
		qcom,mdss-dsi-bl-max-level = <255>;
		qcom,mdss-brightness-max-level = <255>;
		qcom,mdss-brightness-default-level = <30>;
		/* VRR for video mode */
		qcom,dsi-supported-dfps-list = <90 72 60>;
		qcom,mdss-dsi-pan-enable-dynamic-fps;
		qcom,mdss-dsi-pan-fps-update = "dfps_immediate_porch_mode_hfp";

		/* dynamic resolution for video mode */
		qcom,mdss-dms-vid-type = "dms-vid-seamless";

		/* *************************************************************
		 *  Rx (Module Information READ)
		 * *************************************************************
		 */
		samsung,manufacture_id0_rx_cmds_revA	= [06 01 00 00 00 00 01 DA 01 00];
		samsung,manufacture_id1_rx_cmds_revA	= [06 01 00 00 00 00 01 DB 01 00];
		samsung,manufacture_id2_rx_cmds_revA	= [06 01 00 00 00 00 01 DC 01 00];
		samsung,module_info_rx_cmds_revA 	= [06 01 00 00 00 00 01 A1 0D 00];
		samsung,mtp_read_sysfs_rx_cmds_revA	= [06 01 00 00 00 00 01 00 00 00];
		samsung,mtp_write_sysfs_tx_cmds_revA	= [
			39 00 00 00 00 00 3D 00
						00 00 00 00 00 00 00 00 00 00
						00 00 00 00 00 00 00 00 00 00
						00 00 00 00 00 00 00 00 00 00
						00 00 00 00 00 00 00 00 00 00
						00 00 00 00 00 00 00 00 00 00
						00 00 00 00 00 00 00 00 00 00
		];

		samsung,vst_thermistor_rx_cmds_revA 	= [06 01 00 00 00 00 01 62 01 00];

		/*
		 * *******************************************************************
		 *	Below  parameters are samsung dependent things
		 * *******************************************************************
		 */
		samsung,panel-vendor = "SDC";
		samsung,disp-model = "AMM130GZ01";
		samsung,support_gamma_mode2;
		samsung,support_factory_panel_swap;
		/* samsung_power_on_pre_lp11_seq : VDD on -> LP11 -> Delay -> reset */
		samsung,power_on_pre_lp11_seq;
		samsung,power_on_pre_lp11_seq_delay_us = <3000>;
		samsung,reset_after_regulator_off;
		samsung,display_on_tx_cmds_revA = [
			39 00 00 00 00 00 03 9F A5 A5
			39 00 00 00 64 00 01 11 /* SLEEP OUT - delay 100ms */
			39 00 00 00 00 00 02 53 20 /* WRCTLD */
			39 00 00 00 00 00 03 51 04 82 /* BC Control */
			39 00 00 00 00 00 01 29 /* DISPLAY ON */
			39 00 00 00 00 00 03 9F 5A 5A
		];

		/* BRIGHTNESS_MAX_PACKET = 100 */
		samsung,brightness_tx_cmds_revA = [
			39 00 00 00 00 00 01 00
			39 00 00 00 00 00 01 00
			39 00 00 00 00 00 01 00
			39 00 00 00 00 00 01 00
			39 00 00 00 00 00 01 00
			39 00 00 00 00 00 01 00
			39 00 00 00 00 00 01 00
			39 00 00 00 00 00 01 00
			39 00 00 00 00 00 01 00
			39 00 00 00 00 00 01 00
			39 00 00 00 00 00 01 00
			39 00 00 00 00 00 01 00
			39 00 00 00 00 00 01 00
			39 00 00 00 00 00 01 00
			39 00 00 00 00 00 01 00
			39 00 00 00 00 00 01 00
			39 00 00 00 00 00 01 00
			39 00 00 00 00 00 01 00
			39 00 00 00 00 00 01 00
			39 00 00 00 00 00 01 00
			39 00 00 00 00 00 01 00
			39 00 00 00 00 00 01 00
			39 00 00 00 00 00 01 00
			39 00 00 00 00 00 01 00
			39 00 00 00 00 00 01 00
			39 00 00 00 00 00 01 00
			39 00 00 00 00 00 01 00
			39 00 00 00 00 00 01 00
			39 00 00 00 00 00 01 00
			39 00 00 00 00 00 01 00
			39 00 00 00 00 00 01 00
			39 00 00 00 00 00 01 00
			39 00 00 00 00 00 01 00
			39 00 00 00 00 00 01 00
			39 00 00 00 00 00 01 00
			39 00 00 00 00 00 01 00
			39 00 00 00 00 00 01 00
			39 00 00 00 00 00 01 00
			39 00 00 00 00 00 01 00
			39 00 00 00 00 00 01 00
			39 00 00 00 00 00 01 00
			39 00 00 00 00 00 01 00
			39 00 00 00 00 00 01 00
			39 00 00 00 00 00 01 00
			39 00 00 00 00 00 01 00
			39 00 00 00 00 00 01 00
			39 00 00 00 00 00 01 00
			39 00 00 00 00 00 01 00
			39 00 00 00 00 00 01 00
			39 00 00 00 00 00 01 00
			39 00 00 00 00 00 01 00
			39 00 00 00 00 00 01 00
			39 00 00 00 00 00 01 00
			39 00 00 00 00 00 01 00
			39 00 00 00 00 00 01 00
			39 00 00 00 00 00 01 00
			39 00 00 00 00 00 01 00
			39 00 00 00 00 00 01 00
			39 00 00 00 00 00 01 00
			39 00 00 00 00 00 01 00
			39 00 00 00 00 00 01 00
			39 00 00 00 00 00 01 00
			39 00 00 00 00 00 01 00
			39 00 00 00 00 00 01 00
			39 00 00 00 00 00 01 00
			39 00 00 00 00 00 01 00
			39 00 00 00 00 00 01 00
			39 00 00 00 00 00 01 00
			39 00 00 00 00 00 01 00
			39 00 00 00 00 00 01 00
			39 00 00 00 00 00 01 00
			39 00 00 00 00 00 01 00
			39 00 00 00 00 00 01 00
			39 00 00 00 00 00 01 00
			39 00 00 00 00 00 01 00
			39 00 00 00 00 00 01 00
			39 00 00 00 00 00 01 00
			39 00 00 00 00 00 01 00
			39 00 00 00 00 00 01 00
			39 00 00 00 00 00 01 00
			39 00 00 00 00 00 01 00
			39 00 00 00 00 00 01 00
			39 00 00 00 00 00 01 00
			39 00 00 00 00 00 01 00
			39 00 00 00 00 00 01 00
			39 00 00 00 00 00 01 00
			39 00 00 00 00 00 01 00
			39 00 00 00 00 00 01 00
			39 00 00 00 00 00 01 00
			39 00 00 00 00 00 01 00
			39 00 00 00 00 00 01 00
			39 00 00 00 00 00 01 00
			39 00 00 00 00 00 01 00
			39 00 00 00 00 00 01 00
			39 00 00 00 00 00 01 00
			39 00 00 00 00 00 01 00
			39 00 00 00 00 00 01 00
			39 00 00 00 00 00 01 00
			39 00 00 00 00 00 01 00
			39 00 00 00 00 00 01 00
		];

		samsung,gamma_mode2_normal_tx_cmds_revA = [
			39 00 00 00 00 00 03 51 0F 0A
		];

		samsung,candela_map_table_revA = < /* THIS TABLE USED FOR DIMMING */
		/* <idx> <from> <till> <gm2_wrdisbv> <cd> */
			0	0	30	1154	300
			1	31	60	1539	400
			2	61	90	1924	500
			3	91	120	2309	600
			4	121	150	2694	700
			5	151	180	3079	800
			6	181	210	3464	900
			7	211	255	3850	1000
		>;

		/*
		* ************************************************************************************************************************
		* MULTI_RESOLUTION (DSC configs were moved all to below timing set)
		* (C10P does not support MULTI_RESOLUTION, only FHD.)
		* ************************************************************************************************************************
		*/
		qcom,mdss-dsi-display-timings {
			4K90 {
				qcom,display-topology = <4 4 2>;
				qcom,default-topology-index = <0>;

				qcom,mdss-dsi-panel-width = <1776>; /* 2544 / 2(intf_num) */
				qcom,mdss-dsi-panel-height = <3840>;

				qcom,mdss-dsi-t-clk-pre = <0x24>;
				qcom,mdss-dsi-t-clk-post = <0x11>;
				qcom,mdss-dsi-panel-phy-timings = [00 2F 0D 0D 1E 28 0C 0D 0C 02 04 00 27 11];
				qcom,mdss-dsi-panel-framerate = <90>;

				qcom,mdss-dsi-h-pulse-width = <2>;
				qcom,mdss-dsi-h-back-porch = <52>;
				qcom,mdss-dsi-h-front-porch = <54>;
				qcom,mdss-dsi-h-sync-skew = <0>;
				qcom,mdss-dsi-v-pulse-width = <4>;
				qcom,mdss-dsi-v-back-porch = <57>;
				qcom,mdss-dsi-v-front-porch = <35>;
				qcom,mdss-dsi-on-command = [
					39 00 00 00 00 00 03 F0 5A 5A
					39 00 00 00 00 00 03 FC 5A 5A
					39 00 00 00 00 00 03 9F A5 A5
					39 00 00 00 00 00 5F 9E
						11 00 00 89 30 80 0F 00
						0D E0 00 18 03 78 03 78
						02 00 02 BC 00 20 02 DD
						00 0C 00 0C 04 2D 02 94
						18 00 10 F0 03 0C 20 00
						06 0B 0B 33 0E 1C 2A 38
						46 54 62 69 70 77 79 7B
						7D 7E 01 02 01 00 09 40
						09 BE 19 FC 19 FA 19 F8
						1A 38 1A 78 1A B6 2A F6
						2B 34 2B 74 3B 74 6B F4
						00 00 00 00 00 00
					39 00 00 00 00 00 02 BD 00 /* Freq. SETTING */
					39 00 00 00 00 00 02 DD 2F /* Panel update */
					39 00 00 00 00 00 02 83 00 /* FQ_SEL */
					39 00 00 00 0A 00 02 DD 2F /* Panel update */
					39 00 00 00 00 00 02 B5 00 /* Temp Read enable */
					39 00 00 00 00 00 03 9F 5A 5A
					39 00 00 00 00 00 03 FC A5 A5
					39 00 00 00 00 00 03 F0 A5 A5
				];

				qcom,mdss-dsi-on-command-state = "dsi_hs_mode";
				qcom,mdss-dsi-pre-off-command=[
					39 00 00 00 11 00 03 9F A5 A5
					39 00 00 00 11 00 01 28        /* display off */
					39 00 00 00 78 00 01 10        /* sleep in + 120ms delay */
					39 00 00 00 11 00 03 9F 5A 5A
				];
				qcom,mdss-dsi-pre-off-command-state = "dsi_hs_mode";
				qcom,compression-mode = "dsc";
				qcom,mdss-dsc-slice-height = <24>;
				qcom,mdss-dsc-slice-width = <888>;
				qcom,mdss-dsc-slice-per-pkt = <1>;
				qcom,mdss-dsc-bit-per-component = <8>;
				qcom,mdss-dsc-bit-per-pixel = <8>;
				qcom,mdss-dsc-version = <0x11>;
				qcom,mdss-dsc-block-prediction-enable;
			};
		};
	};
};
